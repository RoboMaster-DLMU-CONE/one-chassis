## west.yml
```yaml
manifest:
  remotes:
    - name: zephyrproject-rtos
      url-base: https://github.com/zephyrproject-rtos
    - name: robomaster-dlmu
      url-base: https://github.com/RoboMaster-DLMU-CONE
    - name: origin
      url-base: https://github.com/RoboMaster-DLMU-CONE

  projects:
    - name: zephyr
      remote: zephyrproject-rtos
      revision: main
      import:
        name-allowlist:
          - cmsis
          - cmsis_6
          - hal_stm32

    - name: one-framework
      remote: robomaster-dlmu
      revision: main
      path: modules/lib/one-framework
      import: true


    - name: one-chassis
      remote: origin
      repo-path: one-chassis
      path: modules/lib/nodes/one-chassis
      revision: main

  self:
    path: one-chassis
```

## zephyr/Kconfig
```kconfig
config ONE_CHASSIS
    bool "one-chassis node for OneFramework"
    depends on ONE_FRAMEWORK
    select ONE_MOTOR
    select CONTROLLER_HUB
    select IMU_HUB
    select NOTIFY_HUB
    help
      Enable one-chassis node.

if ONE_CHASSIS

module = ONE_CHASSIS
module-str = ONE_CHASSIS
source "subsys/logging/Kconfig.template.log_config"

endif # ONE_CHASSIS
```
